## software/supervisor_controller/main/Kconfig
```kconfig
menu "ESP Test Image Processing"
    
    menu "Fake menu"

        config FAK_TOTO
            string "Toto name"
            default ""
            help
            (fake config)

    endmenu

endmenu
```

## supervisor/supervisor_controller/components/web_custom/Kconfig
```kconfig
menu "Custom Wi-Fi Configuration"

    config ESP_STATIC_IP_ADDR
        string "Static IP address"
        default "192.168.209.101"
        help
            Set static IP address.

    config ESP_STATIC_NETMASK_ADDR
        string "Static netmask address"
        default "255.255.255.0"
        help
            Set static netmask address.

    config ESP_STATIC_GW_ADDR
        string "Static gateway address"
        default "192.168.209.1"
        help
            Set static gateway address.

    config ESP_WIFI_STA_SSID
        string "WiFi STA SSID"
        default ""
        help
        WiFi SSID (network name) to connect to or empty for Off.

    config ESP_WIFI_STA_PASSWORD
        string "WiFi STA Password"
        default ""
        help
        WiFi Password if WEP/WPA/WPA2 or empty if Open.

    config ESP_MAXIMUM_RETRY
        int "Maximum retry"
        default 5
        help
        Set the Maximum retry to avoid station reconnecting to the AP unlimited when the AP is really inexistent.

    config ESP_WIFI_AP_SSID
        string "WiFi AP SSID"
        default ""
        help
        WiFi SSID (network name) to open to or empty for Off.

    config ESP_WIFI_AP_PASSWORD
        string "WiFi AP Password"
        default ""
        help
        WiFi Password if WEP/WPA/WPA2 or empty if Open.

endmenu
```

## supervisor/supervisor_controller/sdkconfig.defaults
```kconfig
CONFIG_ESPTOOLPY_FLASHSIZE_4MB=y

CONFIG_ESPTOOLPY_FLASHFREQ_80M=y
CONFIG_ESPTOOLPY_FLASHMODE_QIO=y

CONFIG_CAMERA_MODULE_AI_THINKER=y

CONFIG_SPIRAM=y
CONFIG_SPIRAM_SPEED_80M=y
CONFIG_SPIRAM_BOOT_INIT=y
CONFIG_SPIRAM_USE_MALLOC=y

CONFIG_ESP_STATIC_IP_ADDR="192.168.1.10"
CONFIG_ESP_STATIC_NETMASK_ADDR="255.255.255.0"
CONFIG_ESP_STATIC_GW_ADDR="192.168.1.1"
#CONFIG_ESP_STATIC_GW_ADDR="192.168.1.11"
#CONFIG_ESP_WIFI_STA_SSID="moto e20"
#CONFIG_ESP_WIFI_STA_PASSWORD=""
CONFIG_ESP_WIFI_STA_SSID="Livebox-8CB1"
CONFIG_ESP_WIFI_STA_PASSWORD=""
CONFIG_ESP_WIFI_AP_SSID="vbfhddz"
CONFIG_ESP_WIFI_AP_PASSWORD=""

CONFIG_COMPILER_CXX_EXCEPTIONS=y
CONFIG_COMPILER_CXX_EXCEPTIONS_EMG_POOL_SIZE=0

# Custom partition allowing big application memory in flash
CONFIG_PARTITION_TABLE_CUSTOM=y
CONFIG_PARTITION_TABLE_CUSTOM_FILENAME="partitions.csv"
CONFIG_PARTITION_TABLE_FILENAME="partitions.csv"

# Some options were here before migration to idf 5.0 and seem useful :

CONFIG_ESP_DEFAULT_CPU_FREQ_MHZ_240=y
CONFIG_ESP_DEFAULT_CPU_FREQ_MHZ=240

CONFIG_ESP_TASK_WDT_INIT=n

CONFIG_ESP_IPC_TASK_STACK_SIZE=1536

CONFIG_LOG_DEFAULT_LEVEL_INFO=n
CONFIG_LOG_DEFAULT_LEVEL_VERBOSE=y
CONFIG_LOG_DEFAULT_LEVEL=5
CONFIG_LOG_MAXIMUM_LEVEL=5
```

## test_i2c/esp32_master/i2c_simple/main/Kconfig.projbuild
```kconfig
menu "Example Configuration"

    orsource "$IDF_PATH/examples/common_components/env_caps/$IDF_TARGET/Kconfig.env_caps"

endmenu
```
